## zigbee/main/Kconfig.projbuild
```kconfig
menu "Hisense IR AC"

    config HAC_IR_GPIO
        int "IR LED GPIO"
        range 0 30
        default 20
        help
            GPIO that drives the IR LED module (RMT TX output).

    config HAC_IR_INVERT
        bool "Invert IR output"
        default n
        help
            Invert the RMT output level (RMT channel flags.invert_out).

endmenu
```

## zigbee/sdkconfig.defaults
```kconfig
#
# Partition Table
#
CONFIG_ESPTOOLPY_FLASHSIZE_4MB=y
CONFIG_ESPTOOLPY_FLASHSIZE="4MB"
CONFIG_ESPTOOLPY_HEADER_FLASHSIZE_UPDATE=y
CONFIG_PARTITION_TABLE_CUSTOM=y
CONFIG_PARTITION_TABLE_CUSTOM_FILENAME="partitions.csv"
CONFIG_PARTITION_TABLE_FILENAME="partitions.csv"
CONFIG_PARTITION_TABLE_OFFSET=0x8000
CONFIG_PARTITION_TABLE_MD5=y

#
# mbedTLS
#
CONFIG_MBEDTLS_HARDWARE_AES=n
CONFIG_MBEDTLS_HARDWARE_MPI=n
CONFIG_MBEDTLS_HARDWARE_SHA=n
CONFIG_MBEDTLS_CMAC_C=y
CONFIG_MBEDTLS_SSL_PROTO_DTLS=y
CONFIG_MBEDTLS_KEY_EXCHANGE_ECJPAKE=y
CONFIG_MBEDTLS_ECJPAKE_C=y

#
# Zboss
#
CONFIG_ZB_ENABLED=y
CONFIG_ZB_ZCZR=y
CONFIG_ZB_DEBUG_MODE=y

#
# Hisense IR AC
#
CONFIG_HAC_IR_GPIO=20
```
